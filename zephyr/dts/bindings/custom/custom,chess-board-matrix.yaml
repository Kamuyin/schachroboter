## zephyr/dts/bindings/custom/custom,chess-board-matrix.yaml
```yaml
# yaml-language-server: $schema=https://raw.githubusercontent.com/zephyrproject-rtos/zephyr/main/dts/bindings-schema.yaml

title: Custom Chess Board Matrix Scanner

compatible: "custom,chess-board-matrix"

properties:
  row-gpios:
    type: phandle-array
    required: true
    description: GPIO specs for the 8 row lines (index is row number)

  col-gpios:
    type: phandle-array
    required: true
    description: GPIO specs for the 8 column lines (index is column number)

  pull-up:
    type: boolean
    required: false
    description: If present, columns have external pull-ups

  switch-active-high:
    type: boolean
    required: false
    description: If present, a closed switch reads as logic 1
```

## zephyr/dts/bindings/custom/custom,limit-switch.yaml
```yaml
description: |
  Limit switch (end-stop) for homing stepper motors.
  Uses a power/signal output pin and an input pin to detect switch state.
  Switch is typically Normally Open (NO) - when pressed, connects OUT to IN.

compatible: "custom,limit-switch"

properties:
  out-gpios:
    type: phandle-array
    required: true
    description: |
      GPIO pin used to supply signal (VCC) to the switch.
      Should be configured as output, set HIGH.

  in-gpios:
    type: phandle-array
    required: true
    description: |
      GPIO pin used to read the switch state.
      Should be configured as input with appropriate pull resistor.

  active-high:
    type: boolean
    description: |
      If present, switch is considered triggered when input reads HIGH.
      For NO switches with pull-down, the switch connects OUT (HIGH) to IN when pressed.
```

## zephyr/dts/bindings/custom/custom,servo.yaml
```yaml
# yaml-language-server: $schema=https://raw.githubusercontent.com/zephyrproject-rtos/zephyr/main/dts/bindings-schema.yaml

title: Custom Servo Node

description: |
  Servo control interface via GPIO

compatible: "custom,servo"

properties:
  control-gpios:
    type: phandle-array
    required: true
    description: GPIO spec used to generate servo control pulses
```

## zephyr/dts/bindings/custom/custom,stepper.yaml
```yaml
# yaml-language-server: $schema=https://raw.githubusercontent.com/zephyrproject-rtos/zephyr/main/dts/bindings-schema.yaml

title: Custom Stepper Motor Node

description: |
  GPIO stepper motor interface

compatible: "custom,stepper"

properties:
  pulse-gpios:
    type: phandle-array
    required: true
    description: GPIO spec for the step pulse output

  dir-gpios:
    type: phandle-array
    required: true
    description: GPIO spec for the direction output

  enable-gpios:
    type: phandle-array
    required: false
    description: Optional GPIO spec for the enable output (active high)

  dir-inverted:
    type: boolean
    required: false
    description: If present, logical direction is inverted
```
